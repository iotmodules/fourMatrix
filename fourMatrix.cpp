#include "Arduino.h"
#include "fourMatrix.h"

PROGMEM const unsigned char CH[] = {
3, 8, B00000000, B00000000, B00000000, B00000000, B00000000, // space
1, 8, B01011111, B00000000, B00000000, B00000000, B00000000, // !
3, 8, B00000011, B00000000, B00000011, B00000000, B00000000, // "
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4, 8, B00001000, B00000100, B00001000, B00000100, B00000000, // ~
};


fourMatrix::fourMatrix(int _data, int _load, int _clock, int _num) 
{
  dataPin = _data;
  latchPin = _load;
  clockPin = _clock;
  num = _num;
  for (int i=0; i<80; i++)
    fontBuffer[i] = 0;
}



void fourMatrix::init(){
  
   pinMode(latchPin, OUTPUT);   pinMode(clockPin, OUTPUT); pinMode(dataPin, OUTPUT);
   setCommand(0x0b, 0x07);   //scan limit    
   setCommand(0x09, 0x00);   // matrix mode
   setCommand(0x0c, 0x01);   // awake
   setCommand(0x0f, 0x00);   // display test off
   setCommand(0x0a, 0x01);   // brightness
   ledClear();      
  
}

void fourMatrix::loadAndShift(int scrollSpeed){
  for (int i=1;i<=8;i++){
    for (int j=num;j>=1;j--){
    buffer[j][i] <<= 1;
    buffer[j][i] = ((buffer[j-1][i] & B10000000)>>7)|buffer[j][i];
    }
    buffer[0][i] <<= 1;
  }
  loadPage();
  delay(scrollSpeed);
}


void fourMatrix::printCharWithShift(char c, int scrollSpeed){
  if (c < 32) return;
  c -= 32;
  memcpy_P(fontBuffer, CH + 7*c, 7);
  for (int j=2;j<8;j++){
    for (int i=0;i<8;i++){ 
       buffer[0][i+1] = (fontBuffer[j]>>i & B00000001)<<7;
       if (fontBuffer[0] < j-2) return;
    }
    loadAndShift(scrollSpeed);
  }
}

void fourMatrix::printStringWithShift(char *s, int shift_speed){
  while ( *s  != 0){
    printCharWithShift(*s,shift_speed);
    s++;
  }
}



void fourMatrix::loadPage(){
  for (int k=1;k<=num;k++){  
    for (int j=1;j<=8;j++){
     digitalWrite(latchPin, LOW);
        for (int i=1;i<=num;i++){
          if (i == k){
                  // shift out the bits:
                  shiftOut(dataPin, clockPin, MSBFIRST, j);
                  shiftOut(dataPin, clockPin, MSBFIRST, buffer[num+1-k][j]); 
             }
             else  {
                shiftOut(dataPin, clockPin, MSBFIRST, 0x00);
                 shiftOut(dataPin, clockPin, MSBFIRST, 0x00); 
                 //take the latch pin high so the LEDs will light up:
          }
        }
        digitalWrite(latchPin, LOW);
        digitalWrite(latchPin, HIGH);
    }
  }
}

void fourMatrix::ledClear(){
  for (int i=1;i<=8;i++){ 
    for (int j=0;j<num;j++){
      digitalWrite(latchPin, LOW);
      shiftOut(dataPin, clockPin, MSBFIRST, i);
      shiftOut(dataPin, clockPin, MSBFIRST, 0x00); 
      digitalWrite(latchPin, HIGH);
    }
  }
}

void fourMatrix::setCommand(byte command, byte value)
{
  digitalWrite(latchPin, LOW);    
  for (int i=0; i<num; i++) 
  {
    shiftOut(dataPin, clockPin, MSBFIRST, command);
    shiftOut(dataPin, clockPin, MSBFIRST, value);
  }
  digitalWrite(latchPin, LOW);
  digitalWrite(latchPin, HIGH);
}

void fourMatrix::printMsgToMatrix(String msg, int scrollSpeed){
    char buf[100];
    msg.toCharArray(buf, 100);
    printStringWithShift(buf,scrollSpeed);
}



